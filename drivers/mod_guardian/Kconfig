## drivers/mod_guardian/Kconfig
```kconfig
config SECURITY_GUARDIAN
        bool "Guardian LSM"
        depends on SECURITY
        default n
        help
          If you are unsure how to answer this question, answer N.
```
